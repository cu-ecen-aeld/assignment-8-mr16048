## base_external/package/aesd-chardriver/Config.in
```kconfig
config BR2_PACKAGE_AESD_CHARDRIVER
	bool "aesd-chardriver"
	help
	  Includes the writer executable, finder.sh and tester.sh in the kernel image.
	  Used to understand buildroot external trees and package builds.
```

## base_external/package/aesd-socket/Config.in
```kconfig
config BR2_PACKAGE_AESD_SOCKET
	bool "aesd-socket"
	help
	  Includes the aesdsocket program in the kernel image.
	  Used to understand buildroot external trees and package builds.
```
